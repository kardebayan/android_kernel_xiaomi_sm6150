#include "surya-haptic.dtsi"
#include "surya-msm-audio-lpass.dtsi"
#include "surya-pm61501.dtsi"
#include "surya-pm6150.dtsi"
#include "surya-sdmmagpie-atp.dtsi"
#include "surya-sdmmagpie-camera.dtsi"
#include "surya-sdmmagpie-camera-sensor-idp.dtsi"
#include "surya-sdmmagpie.dtsi"
#include "surya-sdmmagpie-idp.dtsi"
#include "surya-sdmmagpie-idp-overlay.dts"
#include "surya-sdmmagpie-pinctrl.dtsi"
#include "surya-sdmmagpie-qrd.dtsi"
#include "surya-sdmmagpie-qupv3.dtsi"
#include "surya-sdmmagpie-regulator.dtsi"
#include "surya-sdmmagpie-rumi.dtsi"
#include "surya-sdmmagpie-sde-display.dtsi"
#include "surya-sdmmagpie-sde.dtsi"
#include "surya-sdmmagpie-stub-regulator.dtsi"
#include "surya-sdmmagpie-thermal.dtsi"
#include "surya-sdmmagpie-usb.dtsi"
#include "surya-sm6150-audio.dtsi"
#include "surya-sm6150-audio-overlay.dtsi"
#include "surya-sm6150-ext-codec-audio-overlay.dtsi"
#include "surya-sm6150-pinctrl.dtsi"
#include "surya-touchscreen.dtsi"
